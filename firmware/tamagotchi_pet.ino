/*
 * Tamagotchi with Custom Animated Sprites
 * - 3 Growth Stages: Egg → Child → Adult
 * - Each stage has 2-frame idle animation
 * - Send "TASK_DONE" via BLE to complete tasks and evolve
 *
 * 🔥 SPI MODE with 7-pin OLED
 * Pins: SCK=18, MOSI=23, DC=4, RESET=14, CS=5
 *
 * MODIFICATIONS:
 * - Sprites scaled 2x (32→64 px)
 * - Only task count shown in top-right corner
 * - SPRITES ARE INVERTED (black on white rectangle)
 * - Background stays black, text stays white
 */

#include <Wire.h>
#include <SPI.h>
#include <Adafruit_GFX.h>
#include <Adafruit_SSD1306.h>
#include <BLEDevice.h>
#include <BLEServer.h>
#include <BLEUtils.h>
#include <BLE2902.h>

// ============ Display Configuration ============
#define SCREEN_WIDTH  128
#define SCREEN_HEIGHT 64

// ---------- SPI Pin Definitions ----------
#define OLED_MOSI   23
#define OLED_CLK    18
#define OLED_DC     4
#define OLED_RESET  14
#define OLED_CS     5

Adafruit_SSD1306 display(SCREEN_WIDTH, SCREEN_HEIGHT, &SPI, OLED_DC, OLED_RESET, OLED_CS, 4000000);

// ============ BLE UUIDs ============
#define SERVICE_UUID        "4fafc201-1fb5-459e-8fcc-c5c9c331914b"
#define CHARACTERISTIC_UUID "beb5483e-36e1-4688-b7f5-ea07361b26a8"

// ============ SPRITE DATA (32x32) ============

// ----- EGG STAGE (Stage 0) -----
const unsigned char egg_0 [] PROGMEM = {
  0xff, 0xff, 0xff, 0xff, 0xff, 0xff, 0xff, 0xff, 0xff, 0xff, 0xff, 0xff, 0xff, 0xff, 0xff, 0xff,
  0xff, 0xff, 0xff, 0xff, 0xff, 0xff, 0xff, 0xff, 0xff, 0xff, 0xff, 0xff, 0xff, 0xfc, 0x7f, 0xff,
  0xff, 0xf8, 0x3f, 0xff, 0xff, 0xf3, 0x3f, 0xff, 0xff, 0xf3, 0x9f, 0xff, 0xff, 0xe7, 0xdf, 0xff,
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  0xff, 0xff, 0xff, 0xff, 0xff, 0xff, 0xff, 0xff, 0xff, 0xff, 0xff, 0xff, 0xff, 0xff, 0xff, 0xff
};

const unsigned char egg_1 [] PROGMEM = {
  0xff, 0xff, 0xff, 0xff, 0xff, 0xff, 0xff, 0xff, 0xff, 0xff, 0xff, 0xff, 0xff, 0xff, 0xff, 0xff,
  0xff, 0xff, 0xff, 0xff, 0xff, 0xff, 0xff, 0xff, 0xff, 0xff, 0xff, 0xff, 0xff, 0xfc, 0xff, 0xff,
  0xff, 0xf0, 0x7f, 0xff, 0xff, 0xe3, 0x3f, 0xff, 0xff, 0xc7, 0xcf, 0xff, 0xff, 0xc7, 0xef, 0xff,
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  0xff, 0xff, 0xff, 0xff, 0xff, 0xff, 0xff, 0xff, 0xff, 0xff, 0xff, 0xff, 0xff, 0xff, 0xff, 0xff
};

// ----- CHILD STAGE (Stage 1) -----
const unsigned char child_0 [] PROGMEM = {
  0xff, 0xff, 0xff, 0xff, 0xff, 0xff, 0xff, 0xff, 0xff, 0xff, 0xff, 0xff, 0xff, 0xff, 0xff, 0xff,
  0xff, 0xff, 0xff, 0xff, 0xff, 0xfe, 0x4f, 0xff, 0xff, 0xff, 0x1f, 0xff, 0xff, 0xff, 0xbf, 0xff,
  0xff, 0xfe, 0x1f, 0xff, 0xff, 0xf8, 0xcf, 0xff, 0xff, 0xf3, 0xef, 0xff, 0xff, 0xf6, 0xd7, 0xff,
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  0xff, 0xff, 0xff, 0xff, 0xff, 0xff, 0xff, 0xff, 0xff, 0xff, 0xff, 0xff, 0xff, 0xff, 0xff, 0xff
};

const unsigned char child_1 [] PROGMEM = {
  0xff, 0xff, 0xff, 0xff, 0xff, 0xff, 0xff, 0xff, 0xff, 0xff, 0xff, 0xff, 0xff, 0xff, 0xff, 0xff,
  0xff, 0xff, 0xff, 0xff, 0xff, 0xfe, 0x4f, 0xff, 0xff, 0xff, 0x1f, 0xff, 0xff, 0xff, 0xbf, 0xff,
  0xff, 0xfe, 0x1f, 0xff, 0xff, 0xf8, 0xcf, 0xff, 0xff, 0xf3, 0xef, 0xff, 0xff, 0xf7, 0xf7, 0xff,
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  0xff, 0xff, 0xff, 0xff, 0xff, 0xff, 0xff, 0xff, 0xff, 0xff, 0xff, 0xff, 0xff, 0xff, 0xff, 0xff
};

// ----- ADULT STAGE (Stage 2) -----
const unsigned char adult_0 [] PROGMEM = {
  0xff, 0xff, 0xff, 0xff, 0xff, 0xff, 0xff, 0xff, 0xff, 0xff, 0xff, 0xff, 0xff, 0xff, 0xff, 0xff,
  0xff, 0xfe, 0xff, 0xff, 0xff, 0xe4, 0xff, 0xff, 0xff, 0xf3, 0xff, 0xff, 0xff, 0xfb, 0xff, 0xff,
  0xff, 0xe0, 0x7c, 0xff, 0xff, 0xcf, 0x0c, 0x7f, 0xff, 0x9f, 0xe1, 0x7f, 0xff, 0x35, 0xef, 0x3f,
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  0xff, 0xff, 0xff, 0xff, 0xff, 0xff, 0xff, 0xff, 0xff, 0xff, 0xff, 0xff, 0xff, 0xff, 0xff, 0xff
};

const unsigned char adult_1 [] PROGMEM = {
  0xff, 0xff, 0xff, 0xff, 0xff, 0xff, 0xff, 0xff, 0xff, 0xff, 0xff, 0xff, 0xff, 0xff, 0xff, 0xff,
  0xff, 0xff, 0xff, 0xff, 0xff, 0xfe, 0x3f, 0xff, 0xff, 0xfe, 0x0f, 0xff, 0xff, 0x3f, 0x97, 0xff,
  0xfe, 0x7d, 0xcb, 0xff, 0xfc, 0x49, 0xe9, 0xff, 0xfa, 0xe7, 0xcc, 0xff, 0xfa, 0xf7, 0xce, 0x7f,
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  0xff, 0xff, 0xff, 0xff, 0xff, 0xff, 0xff, 0xff, 0xff, 0xff, 0xff, 0xff, 0xff, 0xff, 0xff, 0xff
};

// ============ Stage Collections ============
#define SPRITE_SIZE 32
#define FRAME_DELAY 200

const unsigned char* eggFrames[] = { egg_0, egg_1 };
const int eggFrameCount = 2;
const unsigned char* childFrames[] = { child_0, child_1 };
const int childFrameCount = 2;
const unsigned char* adultFrames[] = { adult_0, adult_1 };
const int adultFrameCount = 2;

// ============ Pet State ============
struct Pet {
  int stage = 0;
  int hunger = 80;          // kept but not displayed
  int happiness = 80;       // kept but not displayed
  int tasksCompleted = 0;
  int tasksNeeded = 3;
  unsigned long lastDecay;
} pet;

unsigned long lastFrameTime = 0;
int currentFrame = 0;

// ============ Scaled Drawing Function ============
void drawScaledBitmap(int16_t x, int16_t y,
                      const uint8_t *bitmap,
                      int16_t w, int16_t h,
                      uint8_t scale,
                      uint16_t color) {
  for (int16_t row = 0; row < h; row++) {
    for (int16_t col = 0; col < w; col++) {
      if (pgm_read_byte(bitmap + (row * w + col) / 8) & (1 << (7 - (col % 8)))) {
        display.fillRect(x + col * scale, y + row * scale, scale, scale, color);
      }
    }
  }
}

// ============ Get Frames ============
void getFramesForStage(const unsigned char** &frames, int &frameCount) {
  switch(pet.stage) {
    case 0: frames = eggFrames; frameCount = eggFrameCount; break;
    case 1: frames = childFrames; frameCount = childFrameCount; break;
    case 2: frames = adultFrames; frameCount = adultFrameCount; break;
    default: frames = eggFrames; frameCount = eggFrameCount;
  }
}

// ============ Draw Current Frame ============
void drawCurrentFrame() {
  const unsigned char** frames;
  int frameCount;
  getFramesForStage(frames, frameCount);

  display.clearDisplay();  // Black background

  int scale = 2;
  int scaledW = SPRITE_SIZE * scale;   // 64
  int scaledH = SPRITE_SIZE * scale;   // 64

  // Center the sprite
  int x = (SCREEN_WIDTH - scaledW) / 2;
  int y = (SCREEN_HEIGHT - scaledH) / 2;

  // ---- INVERT THE SPRITE ONLY ----
  // 1. Draw a white rectangle behind the sprite
  display.fillRect(x, y, scaledW, scaledH, SSD1306_WHITE);

  // 2. Draw the sprite pixels in BLACK on top of the white rectangle
  drawScaledBitmap(x, y, frames[currentFrame], SPRITE_SIZE, SPRITE_SIZE, scale, SSD1306_BLACK);

  // ---- Draw task count in top-right corner (white on black) ----
  display.setTextSize(1);
  display.setTextColor(SSD1306_WHITE);
  display.setCursor(SCREEN_WIDTH - 20, 0);
  display.print(pet.tasksCompleted);

  display.display();
}

// ============ Animations ============
void playCelebrationAnimation() {
  for (int i = 0; i < 6; i++) {
    display.clearDisplay();
    display.fillRect(0, 0, 128, 64, (i % 2 == 0) ? SSD1306_WHITE : SSD1306_BLACK);
    display.setTextColor((i % 2 == 0) ? SSD1306_BLACK : SSD1306_WHITE);
    display.setCursor(25, 25);
    display.setTextSize(1);
    display.print("TASK DONE!");
    display.display();
    delay(150);
  }
}

void playEvolutionAnimation() {
  for (int i = 0; i < 12; i++) {
    display.invertDisplay(i % 2 == 0);
    display.display();
    delay(120);
  }
  display.invertDisplay(false);
}

// ============ Task Completion ============
void onTaskCompleted() {
  pet.tasksCompleted++;
  playCelebrationAnimation();

  if (pet.tasksCompleted >= pet.tasksNeeded && pet.stage < 2) {
    pet.stage++;
    pet.tasksCompleted = 0;
    pet.tasksNeeded = (pet.stage == 1) ? 3 : 4;
    playEvolutionAnimation();
    Serial.print("🎉 EVOLVED to stage ");
    Serial.println(pet.stage);
  }

  currentFrame = 0;
  lastFrameTime = millis();
  drawCurrentFrame();
}

// ============ Stat Decay (hidden) ============
void updatePetStats() {
  unsigned long now = millis();
  if (now - pet.lastDecay > 30000) {
    pet.lastDecay = now;
    pet.hunger = max(0, pet.hunger - 2);
    pet.happiness = max(0, pet.happiness - 1);
  }
}

// ============ BLE ============
class TaskCallback : public BLECharacteristicCallbacks {
  void onWrite(BLECharacteristic *pCharacteristic) {
    String value = pCharacteristic->getValue();
    if (value.length() > 0) {
      Serial.print("Received: ");
      Serial.println(value);
      if (value == "TASK_DONE") {
        onTaskCompleted();
      }
    }
  }
};

void setupBLE() {
  BLEDevice::init("Tamagotchi_Pet");
  BLEServer *pServer = BLEDevice::createServer();
  BLEService *pService = pServer->createService(SERVICE_UUID);
  BLECharacteristic *pCharacteristic = pService->createCharacteristic(
    CHARACTERISTIC_UUID,
    BLECharacteristic::PROPERTY_READ | BLECharacteristic::PROPERTY_WRITE
  );
  pCharacteristic->setCallbacks(new TaskCallback());
  pCharacteristic->addDescriptor(new BLE2902());
  pService->start();
  pServer->getAdvertising()->start();
  Serial.println("BLE advertising as 'Tamagotchi_Pet'");
}

// ============ Setup ============
void setup() {
  Serial.begin(115200);

  delay(100);

  if (!display.begin(SSD1306_SWITCHCAPVCC, 0)) {
    Serial.println("OLED SPI init failed!");
    for (;;);
  }
  display.clearDisplay();

  // ❌ Remove any display.invertDisplay calls unless you want everything inverted
  // display.invertDisplay(false); // make sure it's off, or just don't call it

  setupBLE();

  pet.lastDecay = millis();
  drawCurrentFrame();
  Serial.println("Ready in SPI mode! Send 'TASK_DONE' via BLE.");
}

// ============ Loop ============
void loop() {
  unsigned long now = millis();

  const unsigned char** frames;
  int frameCount;
  getFramesForStage(frames, frameCount);

  if (now - lastFrameTime >= FRAME_DELAY) {
    lastFrameTime = now;
    currentFrame = (currentFrame + 1) % frameCount;
    drawCurrentFrame();
  }

  updatePetStats();
  delay(10);
}
